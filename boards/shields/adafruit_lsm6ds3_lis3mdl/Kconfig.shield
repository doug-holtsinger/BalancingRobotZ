## boards/shields/adafruit_lsm6ds3_lis3mdl/Kconfig.shield
```kconfig
# Copyright (c) 2022 Nick Ward <nix.ward@gmail.com>
# SPDX-License-Identifier: Apache-2.0

config SHIELD_ADAFRUIT_LSMDS3_LIS3MDL
	def_bool $(shields_list_contains,adafruit_lsm6ds3_lis3mdl)
```

## boards/vendor/nrf52840_custom/Kconfig.nrf52840_custom
```kconfig
# Copyright (c) 2021 Nordic Semiconductor ASA
# SPDX-License-Identifier: Apache-2.0

config BOARD_NRF52840_CUSTOM
	select SOC_NRF52840_QIAA
```

## boards/vendor/nrf52840_custom/board.yml
```yaml
# Copyright (c) 2024 Nordic Semiconductor ASA
# SPDX-License-Identifier: Apache-2.0

board:
  name: nrf52840_custom
  vendor: vendor
  socs:
    - name: nrf52840
```

## drivers/Kconfig
```kconfig
# Copyright (c) 2021 Nordic Semiconductor ASA
# SPDX-License-Identifier: Apache-2.0

menu "Device Drivers"
rsource "i2c/Kconfig"
endmenu
```

## drivers/i2c/Kconfig
```kconfig
# I2C configuration options

# Copyright (c) 2015 Intel Corporation
# SPDX-License-Identifier: Apache-2.0

#
# I2C options
#
menuconfig I2C
	bool "Inter-Integrated Circuit (I2C) bus drivers"
	help
	  Enable I2C Driver Configuration

if I2C

config I2C_DUMP_MESSAGES
	bool "Log I2C transactions"
	depends on LOG
	depends on I2C_LOG_LEVEL_DBG
	help
	  Dump every I2C transaction to the system log as debug level log messages.

config I2C_DUMP_MESSAGES_ALLOWLIST
	bool "Use allowlist for logging of I2C transactions"
	depends on I2C_DUMP_MESSAGES
	depends on DT_HAS_ZEPHYR_I2C_DUMP_ALLOWLIST_ENABLED
	help
	  Use allowlist to specify which devices transactions should be logged.
	  The allowlist is defined in the devicetree using the compatible string of
	  "zephyr,i2c-dump-allowlist" and phandles to the devices that need to be traced.
	  Example of devicetree node:
	  i2c-dump-allowlist {
	    compatible = "zephyr,i2c-dump-allowlist";
	    devices = < &display0 >, < &sensor3 >;
	  };

config I2C_CALLBACK
	bool "I2C asynchronous callback API"
	help
	  API and implementations of i2c_transfer_cb.

config HAS_I2C_RTIO
	bool
	help
	  This option must be selected by I2C controller drivers that optionally implement the RTIO
	  interface.

config I2C_RTIO
	bool "I2C RTIO API"
	depends on HAS_I2C_RTIO
	select RTIO
	help
	  API and implementations of I2C for RTIO

if I2C_RTIO
config I2C_RTIO_SQ_SIZE
	int "Submission queue size for blocking calls"
	default 4
	help
	  Blocking i2c calls when I2C_RTIO is enabled are copied into a per driver
	  submission queue. The queue depth determines the number of possible i2c_msg
	  structs that may be in the array given to i2c_transfer. A sensible default
	  is going to be 4 given the device address, register address, and a value
	  to be read or written.

config I2C_RTIO_CQ_SIZE
	int "Completion queue size for blocking calls"
	default 4
	help
	  Blocking i2c calls when I2C_RTIO is enabled are copied into a per driver
	  submission queue. The queue depth determines the number of possible i2c_msg
	  structs that may be in the array given to i2c_transfer. A sensible default
	  is going to be 4 given the device address, register address, and a value
	  to be read or written.

endif # I2C_RTIO


# Include these first so that any properties (e.g. defaults) below can be
# overridden (by defining symbols in multiple locations)
rsource "Kconfig.nrfx"

config I2C_INIT_PRIORITY
	int "Init priority"
	default KERNEL_INIT_PRIORITY_DEVICE
	help
	  I2C device driver initialization priority.

module = I2C
module-str = i2c
source "subsys/logging/Kconfig.template.log_config"

endif # I2C
```

## drivers/i2c/Kconfig.nrfx
```kconfig
# nrfx I2C support

# Copyright (c) 2018, Nordic Semiconductor ASA
# SPDX-License-Identifier: Apache-2.0

menuconfig I2C_NRFX
	bool "nRF TWIX nrfx drivers"
	default y
	depends on SOC_FAMILY_NORDIC_NRF
	depends on MULTITHREADING
	select PINCTRL
	help
	  Enable support for nrfx TWIX drivers for nRF MCU series.

if I2C_NRFX

# Selection of either i2c0 or i2c1 based on device tree
config HAS_HW_NRF_TWIX0
        def_bool $(dt_nodelabel_enabled_with_compat,i2c0,$(DT_COMPAT_NORDIC_NRF_TWIX))

config HAS_HW_NRF_TWIX1
        def_bool $(dt_nodelabel_enabled_with_compat,i2c1,$(DT_COMPAT_NORDIC_NRF_TWIX))

config NRFX_TWI
        def_bool $(dt_nodelabel_enabled_with_compat,i2c0,$(DT_COMPAT_NORDIC_NRF_TWIX))

# This was the key t get it compiling.
config NRFX_TWI0
       def_bool $(dt_nodelabel_enabled_with_compat,i2c0,$(DT_COMPAT_NORDIC_NRF_TWIX))

# Enable TWIX0 or TWIX1 based on above selection
config I2C_NRFX_TWIX
	def_bool y
	depends on DT_HAS_NORDIC_NRF_TWIX_ENABLED
	select HAS_I2C_RTIO
	select NRFX_TWIX0 if HAS_HW_NRF_TWIX0
	select NRFX_TWIX1 if HAS_HW_NRF_TWIX1

#DSH4
config NRFX_TWIX0
       bool "dummy"
       default y 
       depends on I2C_NRFX_TWIX

config I2C_NRFX_TRANSFER_TIMEOUT
	int "Transfer timeout [ms]"
	default 500
	help
	  Timeout in milliseconds used for each I2C transfer.
	  0 means that the driver should use the K_FOREVER value,
	  i.e. it should wait as long as necessary.

endif # I2C_NRFX
```

## drivers/sensor/Kconfig
```kconfig
menuconfig SENSOR
        bool "Sensor drivers"
        help
          Include sensor drivers in system config

if SENSOR
rsource "lsm6ds3tr-c/Kconfig"
rsource "lis3mdlz/Kconfig"
rsource "qdec_nrfx/Kconfig"
endif
```

## drivers/sensor/lsm6ds3tr-c/Kconfig
```kconfig
menuconfig LSM6DS3TR_C
	bool "LSM6DS3TR-C I2C accelerometer and gyroscope Chip"
	default y
	depends on DT_HAS_ST_LSM6DS3TR_C_ENABLED
	depends on ZEPHYR_HAL_ST_MODULE
	select I2C if $(dt_compat_on_bus,$(DT_COMPAT_ST_LSM6DS3TR_C),i2c)
	select HAS_STMEMSC
	select USE_STDC_LSM6DS3TR_C
	help
	  Enable driver for LSM6DS3TR-C accelerometer and gyroscope
	  sensor.
```

## drivers/sensor/qdec_nrfx/Kconfig
```kconfig
# Copyright (c) 2018, Nordic Semiconductor ASA
# SPDX-License-Identifier: Apache-2.0

# copied from: zephyr/soc/nordic/common/Kconfig.peripherals
config HAS_HW_NRF_QDECZ0
        def_bool $(dt_nodelabel_enabled_with_compat,qdec0,$(DT_COMPAT_NORDIC_NRF_QDECZ))

# copied from: zephyr/modules/hal_nordic/nrfx/Kconfig
config NRFX_QDECZ0
        bool "QDEC0 driver instance"
        depends on $(dt_nodelabel_has_compat,qdec0,$(DT_COMPAT_NORDIC_NRF_QDECZ))
        select NRFX_QDEC

# copied from: zephyr/drivers/sensor/nordic/qdec_nrfx/Kconfig
config QDECZ_NRFX
        bool "Nordic QDEC nrfx driver"
        default y
        depends on DT_HAS_NORDIC_NRF_QDECZ_ENABLED
        select NRFX_QDECZ0 if HAS_HW_NRF_QDECZ0
        select NRFX_QDECZ1 if HAS_HW_NRF_QDECZ1
        select NRFX_QDECZ20 if HAS_HW_NRF_QDECZ20
        select NRFX_QDECZ21 if HAS_HW_NRF_QDECZ21
        select NRFX_QDECZ130 if HAS_HW_NRF_QDECZ130
        select NRFX_QDECZ131 if HAS_HW_NRF_QDECZ131
        select PINCTRL
        help
          Enable support for nrfx QDEC driver for nRF MCU series.
```

## dts/bindings/nordic,nrf-qdecz.yaml
```yaml
# Copyright (c) 2018, Nordic Semiconductor ASA
# SPDX-License-Identifier: Apache-2.0

description: Nordic nRF quadrature decoder (QDEC) node

compatible: "nordic,nrf-qdecz"

include: [sensor-device.yaml, pinctrl-device.yaml]

properties:
  reg:
    required: true

  interrupts:
    required: true

  pinctrl-0:
    required: true

  enable-pin:
    type: int
    description: |
      The enable pin to use, to enable a connected QDEC device

      For pins P0.0 through P0.31, use the pin number. For example,
      to use P0.16 for the A pin, set:

          enable-pin = <16>;

      For pins P1.0 through P1.31, add 32 to the pin number. For
      example, to use P1.2 for the A pin, set:

          enable-pin = <34>;  /* 32 + 2 */

  led-pre:
    type: int
    description: Time LED is enabled prior to sampling event (in us)
    required: true

  steps:
    type: int
    description: Number of steps on the rotating wheel
    required: true

  reportper:
    type: int
    description: |
      Report period 

      - 0   # 10 samples/report
      - 1   # 40 samples/report 
      - 2   # 80 samples/report 
      - 3   # 120 samples/report 
      - 4   # 160 samples/report
      - 5   # 200 samples/report
      - 6   # 240 samples/report
      - 7   # 280 samples/report
      - 8   # 1 sample/report

    enum: [0, 1, 2, 3, 4, 5, 6, 7, 8]

  sampleper:
    type: int
    description: |
      Sample period 

      - 0   # 128 us
      - 1   # 256 us
      - 2   # 512 us
      - 3   # 1024 us
      - 4   # 2048 us
      - 5   # 4096 us
      - 6   # 8192 us
      - 7   # 16384 us
      - 8   # 32768 us
      - 9   # 65536 us
      - 10  # 131072 us

    enum: [0, 1, 2, 3, 4, 5, 6, 7, 8, 9, 10]
```

## dts/bindings/st,lsm6ds3tr-c-i2c.yaml
```yaml
# Copyright (c) 2019 STMicroelectronics
# SPDX-License-Identifier: Apache-2.0

description: |
    STMicroelectronics LSM6DS3TR-C 6-axis IMU (Inertial Measurement Unit) sensor
    accessed through I2C bus

compatible: "st,lsm6ds3tr-c"

include: ["i2c-device.yaml", "st,lsm6ds3tr-c-common.yaml"]

properties:
  accel_pm:
    type: int
    default: 0
    description: |
          Accelerometer power management setting.
            0 # High Performance
            1 # Normal
    enum:
      - 0
      - 1

  accel_range:
    type: int
    default: 0
    description: |
          Accelerometer FS Range setting.
            0 # 2g
            1 # 16g
            2 # 4g
            3 # 8g
    enum:
      - 0
      - 1
      - 2
      - 3

  accel_odr:
    type: int
    default: 0
    description: |
          Accelerometer Output Data Rate setting.
            0 # Power Down
            1 # 12Hz
            2 # 26Hz
            3 # 52Hz
            4 # 104Hz
            5 # 208Hz
            6 # 417Hz
            7 # 833Hz
            8 # 1667Hz
            9 # 3333Hz
            10 # 6667Hz
    enum:
      - 0
      - 1
      - 2
      - 3
      - 4
      - 5
      - 6
      - 7
      - 8
      - 9
      - 10

  gyro_pm:
    type: int
    default: 0
    description: |
          Gyroscope power management setting.
            0 # High Performance
            1 # Normal Mode
    enum:
      - 0
      - 1

  gyro_range:
    type: int
    default: 0
    description: |
          Gyroscope FS Range setting.
            0 # 250dps
            1 # 125dps
            2 # 500dps
            4 # 1000dps
            6 # 2000dps
    enum:
      - 0
      - 1
      - 2
      - 4
      - 6

  gyro_odr:
    type: int
    default: 0
    description: |
          Gyroscope Output Data Rate setting.
            0 # Power Down
            1 # 12Hz
            2 # 26Hz
            3 # 52Hz
            4 # 104Hz
            5 # 208Hz
            6 # 417Hz
            7 # 833Hz
            8 # 1667Hz
            9 # 3333Hz
            10 # 6667Hz
    enum:
      - 0
      - 1
      - 2
      - 3
      - 4
      - 5
      - 6
      - 7
      - 8
      - 9
      - 10
```
